## main/Kconfig.projbuild
```kconfig
menu "Youtube_Project Configuration"

    config ESP_WIFI_SSID
        string "WiFi SSID"
        default "RedSebas"
        help
            SSID (network name) for the example to connect to.

    config ESP_WIFI_PASSWORD
        string "WiFi Password"
        default "dach1574"
        help
            WiFi password (WPA or WPA2) for the example to use.

    config ESP_MAXIMUM_RETRY
        int "Maximum retry"
        default 5
        help
            Set the Maximum retry to avoid station reconnecting to the AP unlimited when the AP is really inexistent.

    config API_KEY
        string "Api Key from Youtube"
        default "AIzaSyCRuQWNdDq7vlEPlJXIxuBbjLKE0-goUkk"
        help
            Set the Api Key to be able to make the HTTP request.

    config CHANNEL_ID
        string "Channel Id from Youtube Channel"
        default "UCuCl93NjLSbGbJEF4IzGWRg"
        help
            Set the Channel ID from Youtube Channel.

endmenu
```
